## config/boards/shields/keyboard/Kconfig.defconfig
```kconfig
# Copyright (c) 2022 The ZMK Contributors
# SPDX-License-Identifier: MIT

if SHIELD_OTG_LEFT

config ZMK_KEYBOARD_NAME
	default "OTG"

config ZMK_SPLIT_BLE_ROLE_CENTRAL
	default y

endif

if SHIELD_OTG_LEFT || SHIELD_OTG_RIGHT

config ZMK_SPLIT
	default y

endif
```

## config/boards/shields/otg/Kconfig.shield
```kconfig
# Copyright (c) 2022 The ZMK Contributors
# SPDX-License-Identifier: MIT

config SHIELD_OTG_LEFT
	def_bool $(shields_list_contains,otg_left)

config SHIELD_OTG_RIGHT
	def_bool $(shields_list_contains,otg_right)
```

## config/boards/shields/rae_dux/Kconfig.shield
```kconfig
# Copyright (c) 2022 The ZMK Contributors
# SPDX-License-Identifier: MIT

config SHIELD_KEYBOARD_LEFT
	def_bool $(shields_list_contains,keyboard_left)

config SHIELD_KEYBOARD_RIGHT
	def_bool $(shields_list_contains,keyboard_right)
```
